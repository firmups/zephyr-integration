## Kconfig
```kconfig
menu "FIRMUPS Agent Module"

config FIRMUPS_AGENT_MODULE
    bool "Enable FIRMUPS agent"
    default y
    help
      Enable support for FIRMUPS Agent Module.
```

## west.yml
```yaml
manifest:
  projects:
    - name: firmups-device-sdk
      path: ./modules/lib/firmups-device-sdk
      url: https://github.com/firmups/device-sdk
      revision: main
      submodules: true
```
